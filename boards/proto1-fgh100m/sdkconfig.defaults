## boards/proto1-fgh100m/sdkconfig.defaults
```kconfig
# ---- Target / console / board (Seeed XIAO ESP32-S3 Plus + Quectel FGH100M) ----
# Same XIAO carrier as boards/proto1 (identical SPI/control pins); the only
# difference is the radio module — a Quectel FGH100M (Wio-WM6180) instead of the
# Seeed mf16858 — which needs its own Board Config File (BCF). Used for the
# RISK-01 IBSS bring-up (see docs/worklog/2026-06-18-risk01-ibss-recon.md).
CONFIG_IDF_TARGET="esp32s3"
CONFIG_ESP_CONSOLE_USB_SERIAL_JTAG=y
CONFIG_ESP_CONSOLE_SECONDARY_NONE=y

# morselib + the HaLow stack do not fit the default app partition.
CONFIG_PARTITION_TABLE_SINGLE_APP_LARGE=y

# Regulatory domain: mmhalow_init() sets the channel list from this. US =
# 902-928 MHz. Without it the stack reports "Channel list not set" and scan
# fails. Valid: AU CA EU GB IN JP KR NZ US.
CONFIG_HALOW_COUNTRY_CODE="US"

# ---- Morse Micro MM6108 shim: XIAO HaLow wiring (same as proto1) ----
CONFIG_MM_RESET_N=1
CONFIG_MM_WAKE=2
CONFIG_MM_BUSY=5
CONFIG_MM_SPI_IRQ=3
CONFIG_MM_SPI_CS=4
CONFIG_MM_SPI_SCK=7
CONFIG_MM_SPI_MISO=8
CONFIG_MM_SPI_MOSI=9

# MM6108 firmware + Board Config File. The FGH100M (Wio-WM6180) uses the Quectel
# BCF; the forum IBSS success report was on this module family.
CONFIG_MMHAL_CHIP_TYPE_MM6108=y
CONFIG_MM_FW_FILE="mm6108.mbin"
CONFIG_MM_BCF_FILE="bcf_fgh100mhaamd.mbin"
```

## boards/proto1-fgh100m/sdkconfig.defaults.esp32s3
```kconfig
# Seeed XIAO ESP32-S3 Plus: 16 MB QIO flash, 8 MB octal PSRAM.
CONFIG_ESPTOOLPY_FLASHSIZE_16MB=y
CONFIG_ESPTOOLPY_FLASHMODE_QIO=y
CONFIG_ESPTOOLPY_FLASHFREQ_80M=y

CONFIG_SPIRAM=y
CONFIG_SPIRAM_MODE_OCT=y
CONFIG_SPIRAM_TYPE_AUTO=y
CONFIG_SPIRAM_SPEED_80M=y

CONFIG_ESP32S3_INSTRUCTION_CACHE_32KB=y
```

## cmake/mm-fw-gen/firmware/Kconfig
```kconfig
# SPDX-License-Identifier: Apache-2.0
# Tracks ESP Component Registry: morsemicro/firmware 2.10.4-esp32-2
menu "Morse Micro Firmware Configuration"
    config MM_BCF_FILE
        string "Morse Micro Board Configuration File"
        default "bcf_fgh100mhaamd.mbin"
        help
            Board Configuration File name. Converted at build time from the
            matching ELF in vendor/morse-firmware/bcf/ (same basename, .bin).

    config MM_FW_FILE
        string "Morse Micro Firmware File"
        default "mm6108.mbin"
        help
            Firmware image name. Converted at build time from the matching ELF
            in vendor/morse-firmware/firmware/ (same basename, .bin).

    choice MMHAL_CHIP_TYPE
        bool "Morse Micro Chip Variant"
        default MMHAL_CHIP_TYPE_MM6108
        help
            Which chip function ops morselib should use.

        config MMHAL_CHIP_TYPE_MM6108
            bool "mmhal_mm6108"
        config MMHAL_CHIP_TYPE_MM8108
            bool "mmhal_mm8108"
    endchoice

endmenu
```
