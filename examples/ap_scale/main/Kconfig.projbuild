## examples/ap_scale/main/Kconfig.projbuild
```kconfig
# Copyright 2026 Morse Micro
#
# SPDX-License-Identifier: Apache-2.0

menu "High-density AP example configuration"

config EXAMPLE_WIFI_SSID
	string "Wi-Fi SSID"
	default "MorseMicroESP32AP"

config EXAMPLE_WIFI_PSK
	string "Wi-Fi passphrase"
	default "12345678"
	help
	    At least 8 characters — required for SAE.

config EXAMPLE_S1G_CHANNEL
	int "S1G channel"
	default 27

config EXAMPLE_S1G_OPCLASS
	int "S1G operating class"
	default 68

config EXAMPLE_AP_IPV4
	string "SoftAP static IPv4 address"
	default "192.168.12.1"
	help
	    The AP runs no DHCP server, so it pins a static address and each station
	    does the same.

config EXAMPLE_AP_MAX_STAS
	int "Stations this AP will admit"
	default 255
	range 1 255
	help
	    Runtime station ceiling, passed as mmwlan_ap_args.max_stas.

	    This must not exceed CONFIG_HALOW_AP_MAX_STAS, which is the compile-time
	    ceiling the per-STA tables are sized to (set to 255 in this example's
	    sdkconfig.defaults). Raising this alone does not enlarge the tables.

config EXAMPLE_REPORT_INTERVAL_S
	int "Station-count report interval (seconds)"
	default 10
	help
	    How often to log the associated-station count and remaining heap, so the
	    memory cost per station is visible as the AP fills up.

endmenu
```

## examples/ibss/main/Kconfig.projbuild
```kconfig
# Copyright 2026 Morse Micro
#
# SPDX-License-Identifier: Apache-2.0

menu "IBSS example configuration"

config EXAMPLE_IBSS_SSID
	string "IBSS SSID"
	default "morse-ibss"
	help
	    Identifies the ad-hoc cell. Must match on every node.

config EXAMPLE_IBSS_BSSID
	string "IBSS BSSID"
	default "02:12:34:56:78:9a"
	help
	    The agreed cell BSSID, identical on every node. It should be
	    locally-administered (the 0x02 bit set).

	    This example assumes a PROVISIONED network: every node is deployed
	    already knowing the BSSID, so there is only ever one cell and no TSF
	    merge is needed. IBSS TSF merge exists to let uncoordinated nodes that
	    each rolled a random BSSID converge on one cell; with a pre-shared BSSID
	    that case does not arise. In a real deployment this value comes from
	    provisioning rather than a literal.

config EXAMPLE_IBSS_S1G_CHANNEL
	int "S1G channel"
	default 27
	help
	    S1G channel number. 27 is 915.5 MHz at 1 MHz bandwidth in the US
	    (global operating class 68). Must match every other node in the cell.

config EXAMPLE_IBSS_IPV4_PREFIX
	string "IPv4 /24 prefix for the ad-hoc subnet"
	default "192.168.13."
	help
	    Each node pins a static address in this /24, with the host octet derived
	    from its own MAC, so one binary runs on every board unmodified.

config EXAMPLE_IBSS_PEER_TIMEOUT_MS
	int "Peer age-out threshold (ms)"
	default 30000
	help
	    A peer not heard from within this window is aged out. Ageing is
	    caller-driven: the application calls mmwlan_ibss_age_peers() itself
	    rather than the driver running a timer.

config EXAMPLE_IBSS_PING_PEERS
	bool "Ping each peer as it is discovered"
	default y
	help
	    Start a 1 Hz ICMP session against every newly discovered peer, so the
	    console shows the data path working as nodes join.

endmenu
```

## examples/mesh/main/Kconfig.projbuild
```kconfig
# SPDX-License-Identifier: Apache-2.0

menu "Mesh example configuration"

config EXAMPLE_MESH_ID
	string "Mesh ID"
	default "morse-mesh"
	help
	    The Mesh ID identifies the mesh BSS — the 802.11s equivalent of an SSID.
	    Every node in the same mesh must use the same value.

config EXAMPLE_MESH_S1G_CHANNEL
	int "S1G channel"
	default 27
	help
	    S1G channel number. 27 is 915.5 MHz at 1 MHz bandwidth in the US
	    (global operating class 68). Must match every other node in the mesh.

config EXAMPLE_MESH_MAX_PLINKS
	int "Maximum mesh peer links"
	default 16
	range 1 16
	help
	    Upper bound on simultaneously established mesh peer links. The mesh
	    peer table is sized to 16 (UMAC_MESH_MAX_PEERS).

config EXAMPLE_MESH_IPV4_PREFIX
	string "IPv4 /24 prefix for the mesh subnet"
	default "10.9.9."
	help
	    Each node pins a static address in this /24. The host octet is derived
	    from the node's own mesh MAC, so one binary runs on every board without
	    per-node configuration. There is no DHCP server on a plain mesh.

config EXAMPLE_MESH_AMPDU
	bool "Enable A-MPDU aggregation"
	default y
	help
	    Aggregate MPDUs into A-MPDUs on the mesh interface. Aggregation is
	    assembled by the MM6108 firmware and negotiated with each peer over a
	    Block Ack (ADDBA) handshake. Measured on a 3-node bench at roughly +37%
	    single-hop and +38% relay throughput.

	    Must be set before the interface is brought up — mmwlan_set_ampdu_enabled()
	    may only be called while MMWLAN is inactive.

config EXAMPLE_MESH_LEAF
	bool "Leaf / single-hop mode"
	default n
	help
	    Run this node as a mesh leaf: it peers with its direct neighbours as
	    normal but never relays another node's traffic, never uses a multi-hop
	    path for its own traffic, and emits no HWMP PREQ/PREP/PERR. Peers
	    therefore never route through it, so it is not a black hole.

	    Useful for a battery-powered node that should not spend energy
	    forwarding for the rest of the mesh.

endmenu
```

## examples/twt_powersave/main/Kconfig.projbuild
```kconfig
# SPDX-License-Identifier: Apache-2.0

menu "TWT power-save example configuration"

choice EXAMPLE_ROLE
	prompt "Role"
	default EXAMPLE_ROLE_STA
	help
	    Which half of the link this board plays. Flash one board as the AP and
	    another as the STA.

config EXAMPLE_ROLE_STA
	bool "Station (TWT requester)"
	help
	    Associates to the AP, negotiates a TWT agreement, and dozes between
	    service periods.

config EXAMPLE_ROLE_AP
	bool "SoftAP (TWT + WNM-sleep responder)"
	help
	    Runs a SoftAP that answers TWT setup requests and WNM-sleep requests,
	    buffering downlink traffic for sleeping stations.

endchoice

config EXAMPLE_WIFI_SSID
	string "Wi-Fi SSID"
	default "MorseMicroESP32AP"
	help
	    Must match between the AP and STA roles.

config EXAMPLE_WIFI_PSK
	string "Wi-Fi passphrase"
	default "12345678"
	help
	    At least 8 characters. SAE is used in both roles.

config EXAMPLE_S1G_CHANNEL
	int "S1G channel"
	default 27

config EXAMPLE_S1G_OPCLASS
	int "S1G operating class"
	default 68

config EXAMPLE_AP_IPV4
	string "SoftAP static IPv4 address"
	default "192.168.12.1"
	depends on EXAMPLE_ROLE_AP
	help
	    The AP role runs no DHCP server, so it pins a static address.

config EXAMPLE_TWT_WAKE_INTERVAL_US
	int "TWT wake interval (microseconds)"
	default 10000000
	depends on EXAMPLE_ROLE_STA
	help
	    Time between the station's scheduled service periods. Longer means
	    deeper idle sleep; shorter means lower downlink latency.

config EXAMPLE_TWT_MIN_WAKE_DURATION_US
	int "TWT minimum wake duration (microseconds)"
	default 65280
	depends on EXAMPLE_ROLE_STA
	help
	    How long the station stays awake for each service period. Must not
	    exceed the wake interval.

config EXAMPLE_TWT_ACTION_FRAME
	bool "Negotiate TWT mid-session with an action frame"
	default n
	depends on EXAMPLE_ROLE_STA
	help
	    By default the station adds its TWT configuration BEFORE associating, so
	    the request rides inside the (re)association IEs. That is the portable
	    path: an AP's assoc-time TWT responder handles it, and hostapd enables
	    one by default.

	    Enable this to instead associate first and then send a TWT Setup Request
	    action frame. It is assoc-preserving and can be renegotiated at runtime,
	    but not every AP answers it.

config EXAMPLE_STA_WNM_SLEEP
	bool "Enter WNM-sleep with chip power-down after the TWT phase"
	default n
	depends on EXAMPLE_ROLE_STA
	help
	    WNM-sleep lets the station stay associated while the radio sleeps for an
	    extended period, with the AP buffering its downlink. Combined with chip
	    power-down it is the lowest-power state that still keeps the association.

	    Requires the AP to implement a WNM-sleep responder, and PMF.

endmenu
```
